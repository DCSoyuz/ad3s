## ad3s_prog_esp32/main/Kconfig.projbuild
```kconfig
menu "AD3S Board Configuration"

    orsource "$IDF_PATH/examples/common_components/env_caps/$IDF_TARGET/Kconfig.env_caps"

    choice VERSION_BOARD
        prompt "Version board"
        default DEV_BOARD_065A022
        help
            Select the board variant to match your hardware (pin mappings are
            defined in main/ad3s_types.hpp).

            - "Dev board for 065A-022" — the factory debug/development board for
              the 5400TP065A-022 chip (default).
            - "Custom User Board" — any other ESP32-S3 module wired to the chip.
              Edit the pin mapping in the CONFIG_CUSTOM_USER_BOARD block of
              main/ad3s_types.hpp to match your wiring before building.

        config DEV_BOARD_065A022
            bool "Dev board for 065A-022"
        config CUSTOM_USER_BOARD
            bool "Custom User Board"
            help
                Any ESP32-S3 module wired to the 5400TP065A-022 chip. The default
                pin mapping is a working reference; replace it with your own in the
                CONFIG_CUSTOM_USER_BOARD block of main/ad3s_types.hpp. See README.md.

        # --- Hidden / legacy board variants (kept for reference, not offered to the user) ---
        # config SKVT_VERIFY
        #     bool "SKVT Verify"
        # config INDUCTOSYN_VER2
        #     bool "Inductosyn ver2"
        # config USER_ANY_BOARD
        #     bool "User Any Board (custom pins)"
    endchoice



    choice BLINK_LED
        prompt "Blink LED type"
        default BLINK_LED_GPIO
        help
            Select the LED type. A normal level controlled LED or an addressable LED strip.
            The default selection is based on the Espressif DevKit boards.
            You can change the default selection according to your board.

        config BLINK_LED_GPIO
            bool "GPIO"
        config BLINK_LED_STRIP
            bool "LED strip"
    endchoice

    choice BLINK_LED_STRIP_BACKEND
        depends on BLINK_LED_STRIP
        prompt "LED strip backend peripheral"
        default BLINK_LED_STRIP_BACKEND_RMT if SOC_RMT_SUPPORTED
        default BLINK_LED_STRIP_BACKEND_SPI
        help
            Select the backend peripheral to drive the LED strip.

        config BLINK_LED_STRIP_BACKEND_RMT
            depends on SOC_RMT_SUPPORTED
            bool "RMT"
        config BLINK_LED_STRIP_BACKEND_SPI
            bool "SPI"
    endchoice

    config BLINK_GPIO
        int "Blink GPIO number"
        range 0 50
        default 8
        help
            GPIO number (IOxx) to blink on and off the LED.
            Some GPIOs are used for other purposes (flash connections, etc.) and cannot be used to blink.

    config BLINK_PERIOD
        int "Blink period in ms"
        range 10 3600000
        default 1000
        help
            Define the blinking period in milliseconds.

endmenu
```

## ad3s_prog_esp32/sdkconfig.defaults
```kconfig
# ============================================================================
# sdkconfig.defaults — настройки проекта ad3s_prog_esp32
# ----------------------------------------------------------------------------
# Эти значения применяются автоматически при `idf.py set-target esp32s3`,
# `fullclean`+`reconfigure`, смене версии ESP-IDF или свежем клоне — их НЕ нужно
# выставлять вручную в menuconfig. Локальный файл `sdkconfig` может
# перегенерироваться из этих дефолтов; правьте проектные значения здесь.
# ============================================================================

# --- TinyUSB CDC: виртуальный COM-порт для связи с Workstation4ad3s -----------
# Без CONFIG_TINYUSB_CDC_ENABLED=y прошивка НЕ собирается: usb_cdc.cpp/hpp
# используют CDC ACM API и CONFIG_TINYUSB_CDC_RX_BUFSIZE. По умолчанию в
# компоненте esp_tinyusb эта опция ВЫКЛЮЧЕНА (default n), поэтому фиксируем тут.
CONFIG_TINYUSB_CDC_ENABLED=y
CONFIG_TINYUSB_CDC_COUNT=1
CONFIG_TINYUSB_CDC_RX_BUFSIZE=2048
CONFIG_TINYUSB_CDC_TX_BUFSIZE=4096
CONFIG_TINYUSB_CDC_EP_BUFSIZE=2048
```
